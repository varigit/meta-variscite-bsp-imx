## conf/machine/imx8mp-var-dart.conf
```bitbake
#@TYPE: Machine
#@NAME: Variscite DART-MX8M-PLUS
#@SOC: i.MX8MP
#@DESCRIPTION: Machine configuration for Variscite DART-MX8M-PLUS and VAR-SOM-MX8M-PLUS
#@MAINTAINER: Nate Drude <nate.d@variscite.com>
#
# http://www.variscite.com

MACHINEOVERRIDES =. "mx8mp:"

require conf/machine/include/imx-base.inc
require conf/machine/include/arm/armv8a/tune-cortexa53.inc

require include/variscite.inc
require include/variscite_bcm43xx.inc

# Variscite BSP default providers
PREFERRED_PROVIDER_virtual/kernel:imx8mp-var-dart ?= "linux-variscite"
PREFERRED_PROVIDER_u-boot:imx8mp-var-dart ?= "u-boot-variscite"
PREFERRED_PROVIDER_u-boot-fw-utils:imx8mp-var-dart ?= "u-boot-fw-utils"
PREFERRED_PROVIDER_virtual/bootloader:imx8mp-var-dart ?= "u-boot-variscite"

MACHINE_FEATURES += "nxpiw612-sdio"

KERNEL_DEVICETREE = " \
	freescale/imx8mp-var-dart-1.x-dt8mcustomboard.dtb \
	freescale/imx8mp-var-dart-1.x-dt8mcustomboard-m7.dtb \
	freescale/imx8mp-var-dart-1.x-dt8mcustomboard-basler-isp0.dtb \
	freescale/imx8mp-var-dart-dt8mcustomboard.dtb \
	freescale/imx8mp-var-dart-dt8mcustomboard-m7.dtb \
	freescale/imx8mp-var-dart-dt8mcustomboard-basler-isp0.dtb \
	freescale/imx8mp-var-dart-wbe-dt8mcustomboard.dtb \
	freescale/imx8mp-var-dart-wbe-dt8mcustomboard-m7.dtb \
	freescale/imx8mp-var-dart-wbe-dt8mcustomboard-basler-isp0.dtb \
	freescale/imx8mp-var-som-1.x-symphony.dtb \
	freescale/imx8mp-var-som-1.x-symphony-m7.dtb \
	freescale/imx8mp-var-som-1.x-symphony-2nd-ov5640.dtb \
	freescale/imx8mp-var-som-1.x-symphony-2nd-ov5640-m7.dtb \
	freescale/imx8mp-var-som-1.x-symphony-basler-isi0.dtb \
	freescale/imx8mp-var-som-1.x-symphony-basler-isi0-m7.dtb \
	freescale/imx8mp-var-som-1.x-symphony-basler-isp0.dtb \
	freescale/imx8mp-var-som-1.x-symphony-basler-isp0-m7.dtb \
	freescale/imx8mp-var-som-symphony.dtb \
	freescale/imx8mp-var-som-symphony-m7.dtb \
	freescale/imx8mp-var-som-symphony-2nd-ov5640.dtb \
	freescale/imx8mp-var-som-symphony-2nd-ov5640-m7.dtb \
	freescale/imx8mp-var-som-symphony-basler-isi0.dtb \
	freescale/imx8mp-var-som-symphony-basler-isi0-m7.dtb \
	freescale/imx8mp-var-som-symphony-basler-isp0.dtb \
	freescale/imx8mp-var-som-symphony-basler-isp0-m7.dtb \
	freescale/imx8mp-var-som-wbe-symphony.dtb \
	freescale/imx8mp-var-som-wbe-symphony-m7.dtb \
	freescale/imx8mp-var-som-wbe-symphony-2nd-ov5640.dtb \
	freescale/imx8mp-var-som-wbe-symphony-2nd-ov5640-m7.dtb \
	freescale/imx8mp-var-som-wbe-symphony-basler-isi0.dtb \
	freescale/imx8mp-var-som-wbe-symphony-basler-isi0-m7.dtb \
	freescale/imx8mp-var-som-wbe-symphony-basler-isp0.dtb \
	freescale/imx8mp-var-som-wbe-symphony-basler-isp0-m7.dtb \
"

MACHINE_EXTRA_RRECOMMENDS:remove = " imx-m7-demos"

UBOOT_CONFIG ??= "sd"
UBOOT_CONFIG[sd] = "imx8mp_var_dart_config,sdcard"
SPL_BINARY = "spl/u-boot-spl.bin"

ATF_PLATFORM = "imx8mp"
ATF_LOAD_ADDR = "0x970000"

# Set DDR FIRMWARE
DDR_FIRMWARE_NAME = " \
	lpddr4_pmu_train_1d_dmem_202006.bin \
	lpddr4_pmu_train_1d_imem_202006.bin \
	lpddr4_pmu_train_2d_dmem_202006.bin \
	lpddr4_pmu_train_2d_imem_202006.bin \
"

# Set U-Boot DTB
UBOOT_DTB_NAME  = "imx8mp-var-dart-dt8mcustomboard.dtb"
UBOOT_DTB_EXTRA = "imx8mp-var-som-symphony.dtb"

# Set imx-mkimage boot target
IMXBOOT_TARGETS = "flash_evk"

IMX_BOOT_SOC_TARGET = "iMX8MP"

# Extra firmware package name, that is required to build boot container for fslc bsp
IMX_EXTRA_FIRMWARE = "firmware-imx-8m"

SERIAL_CONSOLES = "115200;ttymxc0 115200;ttymxc1"

IMAGE_BOOTLOADER = "imx-boot"

ROOTFS_SIZE = "3700"
LOADADDR = ""
UBOOT_SUFFIX = "bin"
UBOOT_MAKE_TARGET = "all"
IMX_BOOT_SEEK = "32"

PREFERRED_PROVIDER_u-boot:imx8mp-var-dart = "u-boot-variscite"
PREFERRED_PROVIDER_virtual/bootloader:imx8mp-var-dart = "u-boot-variscite"

TEE_CFG_DDR_SIZE ?= "0x100000000"
```

## conf/machine/imx8qm-var-som.conf
```bitbake
#@TYPE: Machine
#@NAME: Variscite VAR-SOM-MX8
#@SOC: i.MX8QM
#@DESCRIPTION: Machine configuration for Variscite VAR-SOM-MX8
#@MAINTAINER: Nate Drude <nate.d@variscite.com>
#
# http://www.variscite.com

MACHINEOVERRIDES =. "mx8qm:"

require conf/machine/include/imx-base.inc
require conf/machine/include/tune-cortexa72-cortexa53.inc

require variscite.inc
require variscite_bcm43xx.inc

# Variscite BSP default providers
PREFERRED_PROVIDER_virtual/kernel:imx8qm-var-som ?= "linux-variscite"
PREFERRED_PROVIDER_u-boot:imx8qm-var-som ?= "u-boot-variscite"
PREFERRED_PROVIDER_u-boot-fw-utils:imx8qm-var-som ?= "u-boot-fw-utils"
PREFERRED_PROVIDER_virtual/bootloader:imx8qm-var-som ?= "u-boot-variscite"

KERNEL_DEVICETREE = " \
	freescale/imx8qm-var-som-symphony-dp.dtb \
	freescale/imx8qm-var-som-symphony-hdmi.dtb \
	freescale/imx8qm-var-som-symphony-lvds.dtb \
	freescale/imx8qm-var-spear-sp8customboard-dp.dtb \
	freescale/imx8qm-var-spear-sp8customboard-hdmi.dtb \
	freescale/imx8qm-var-spear-sp8customboard-lvds.dtb \
	freescale/imx8qm-var-som-symphony-dp-m4.dtb \
	freescale/imx8qm-var-som-symphony-hdmi-m4.dtb \
	freescale/imx8qm-var-som-symphony-lvds-m4.dtb \
	freescale/imx8qm-var-spear-sp8customboard-dp-m4.dtb \
	freescale/imx8qm-var-spear-sp8customboard-hdmi-m4.dtb \
	freescale/imx8qm-var-spear-sp8customboard-lvds-m4.dtb \
	freescale/imx8qp-var-som-symphony-dp.dtb \
	freescale/imx8qp-var-som-symphony-hdmi.dtb \
	freescale/imx8qp-var-som-symphony-lvds.dtb \
	freescale/imx8qp-var-spear-sp8customboard-dp.dtb \
	freescale/imx8qp-var-spear-sp8customboard-hdmi.dtb \
	freescale/imx8qp-var-spear-sp8customboard-lvds.dtb \
	freescale/imx8qp-var-som-symphony-dp-m4.dtb \
	freescale/imx8qp-var-som-symphony-hdmi-m4.dtb \
	freescale/imx8qp-var-som-symphony-lvds-m4.dtb \
	freescale/imx8qp-var-spear-sp8customboard-dp-m4.dtb \
	freescale/imx8qp-var-spear-sp8customboard-hdmi-m4.dtb \
	freescale/imx8qp-var-spear-sp8customboard-lvds-m4.dtb \
"

SPL_BINARY = "spl/u-boot-spl.bin"
UBOOT_SUFFIX = "bin"
UBOOT_CONFIG ??= "sd"
UBOOT_CONFIG[sd] = "imx8qm_var_som_defconfig,sdcard"

ATF_PLATFORM = "imx8qm"
IMX_BOOT_SOC_TARGET = "iMX8QM"

# Set U-Boot DTB
UBOOT_DTB_NAME = "imx8qm-var-som-symphony.dtb"

# Set imx-mkimage boot target
IMXBOOT_TARGETS = "flash_spl"

SERIAL_CONSOLES = "115200;ttyLP0"

IMAGE_BOOTLOADER = "imx-boot"

ROOTFS_SIZE = "3700"
LOADADDR = ""
UBOOT_MAKE_TARGET = "all"
IMX_BOOT_SEEK = "32"

IMAGE_BOOTFILES_DEPENDS += "firmware-imx:do_deploy"
IMAGE_BOOTFILES += "hdmitxfw.bin hdmirxfw.bin dpfw.bin"

MACHINE_EXTRA_RDEPENDS += " firmware-imx-hdmi"
```

## conf/machine/imx8qxpb0-var-som.conf
```bitbake
#@TYPE: Machine
#@NAME: Variscite VAR-SOM-MX8X
#@SOC: i.MX8QXP
#@DESCRIPTION: Machine configuration for Variscite VAR-SOM-MX8X
#@MAINTAINER: Nate Drude <nate.d@variscite.com>
#
# http://www.variscite.com

MACHINEOVERRIDES =. "mx8qxp:"
require conf/machine/include/imx-base.inc
require conf/machine/include/tune-cortexa35.inc

require variscite.inc
require variscite_bcm43xx.inc

# Variscite BSP default providers
PREFERRED_PROVIDER_virtual/kernel:imx8qxpb0-var-som ?= "linux-variscite"
PREFERRED_PROVIDER_u-boot:imx8qxpb0-var-som ?= "u-boot-variscite"
PREFERRED_PROVIDER_u-boot-fw-utils:imx8qxpb0-var-som ?= "u-boot-fw-utils"
PREFERRED_PROVIDER_virtual/bootloader:imx8qxpb0-var-som ?= "u-boot-variscite"

MACHINE_FEATURES += "soc-revb0"

KERNEL_DEVICETREE = " \
	freescale/imx8qxp-var-som-symphony-sd.dtb \
	freescale/imx8qxp-var-som-symphony-wifi.dtb \
	freescale/imx8qxp-var-som-symphony-wifi-m4.dtb \
	freescale/imx8qxp-var-som-symphony-sd-m4.dtb \
"

SPL_BINARY = "spl/u-boot-spl.bin"
UBOOT_SUFFIX = "bin"
UBOOT_CONFIG ??= "sd"
UBOOT_CONFIG[sd] = "imx8qxp_var_som_defconfig,sdcard"

ATF_PLATFORM = "imx8qx"
IMX_BOOT_SOC_TARGET = "iMX8QX"

# Set U-Boot DTB
UBOOT_DTB_NAME = "imx8qxp-var-som-symphony.dtb"

# Set imx-mkimage boot target
IMXBOOT_TARGETS = "flash_spl"

SERIAL_CONSOLES = "115200;ttyLP3"

IMAGE_BOOTLOADER = "imx-boot"

ROOTFS_SIZE = "3700"
LOADADDR = ""
UBOOT_MAKE_TARGET = "all"
IMX_BOOT_SEEK = "32"
```

## conf/machine/include/variscite.inc
```bitbake
require variscite-mirrors.inc
INHERIT += "image-buildinfo"

# Common override for all Variscite machines
MACHINEOVERRIDES =. "var-som:"

MACHINE_FEATURES += " pci bluetooth wifi screen"

IMX_DEFAULT_BSP = "nxp"

USE_VT = "0"

KERNEL_IMAGETYPE:mx8-nxp-bsp = "Image.gz"
KERNEL_IMAGETYPE:mx9-nxp-bsp = "Image.gz"

WKS_FILE:mx8-nxp-bsp ?= "imx-imx-boot-singlepart.wks.in"
WKS_FILE:mx9-nxp-bsp ?= "imx-imx-boot-singlepart.wks.in"

# Set a more generic tuning for code reuse across parts
DEFAULTTUNE:mx8-nxp-bsp:fslc     ?= "armv8a-crc-crypto"
DEFAULTTUNE:mx8m-nxp-bsp:fslc    ?= "armv8a-crc-crypto"
DEFAULTTUNE:mx8qxp-nxp-bsp:fslc  ?= "armv8a-crc-crypto"
DEFAULTTUNE:mx8x-nxp-bsp:fslc    ?= "armv8a-crc-crypto"

NETMAN_PACKAGES = "\
    networkmanager \
    networkmanager-nmcli \
"

# Yocto distros should default to systemd-networkd
PREFERRED_CONNECTIVITY_MANAGER	 ?= " \
    ${@bb.utils.contains('DISTRO', 'b2qt', '', 'systemd-networkd', d)} \
"
PREFERRED_CONNECTIVITY_MANAGER_PACKAGES	?= " \
    ${@bb.utils.contains('PREFERRED_CONNECTIVITY_MANAGER', 'networkmanager', \
        '${NETMAN_PACKAGES}','', d)} \
"

# Variscite BSP default providers
PREFERRED_PROVIDER_virtual/kernel ?= "linux-variscite"

PREFERRED_PROVIDER_u-boot ?= "u-boot-variscite"
PREFERRED_PROVIDER_virtual/bootloader ?= "u-boot-variscite"
PREFERRED_RPROVIDER_u-boot-default-env ?= "u-boot-variscite"
PREFERRED_PROVIDER_u-boot-fw-utils ?= "u-boot-fw-utils"

# Use i.MX Gstreamer Version
MACHINE_GSTREAMER_1_0_PLUGIN:mx6-nxp-bsp = "imx-gst1.0-plugin"
MACHINE_GSTREAMER_1_0_PLUGIN:mx7-nxp-bsp = "imx-gst1.0-plugin"
MACHINE_GSTREAMER_1_0_PLUGIN:mx8-nxp-bsp = "imx-gst1.0-plugin"

# Add VPU and Cortex M4/M7 firmware
MACHINE_FIRMWARE:append:mx8-nxp-bsp = " \
    firmware-imx-vpu-imx8 \
    freertos-variscite-dbg \
    freertos-variscite-scripts \
"

# Add Cortex-M33 firmware
MACHINE_FIRMWARE:append:imx93-var-som = " \
    freertos-variscite \
    freertos-variscite-scripts \
"

MACHINE_ESSENTIAL_EXTRA_RDEPENDS:mx8-nxp-bsp = " \
    kernel-image \
    kernel-devicetree \
"

MACHINE_ESSENTIAL_EXTRA_RDEPENDS:mx9-nxp-bsp = " \
    kernel-image \
    kernel-devicetree \
"

MACHINE_EXTRA_RDEPENDS += " \
    imx-kobs \
    kernel-modules \
    pm-utils-variscite \
    u-boot-fw-utils \
    u-boot-splash \
    u-boot-default-env \
    ${@bb.utils.contains('MACHINE_FEATURES', 'nxpiw612-sdio', 'iw612-utils', '', d)} \
"

CORE_IMAGE_EXTRA_INSTALL += " \
    packagegroup-tools-bluetooth \
    packagegroup-variscite-devel \
    ${PREFERRED_CONNECTIVITY_MANAGER_PACKAGES} \
"

IMAGE_FSTYPES = "tar.zst wic.zst wic.bmap wic"

# Use bluez-alsa instead of pulseaudio
DISTRO_FEATURES_BACKFILL_CONSIDERED:append = " pulseaudio"

# Enable virtualization
DISTRO_FEATURES:append = " virtualization"
```

## conf/machine/variscite.inc
```bitbake
require variscite-mirrors.inc
INHERIT += "image-buildinfo"

MACHINE_FEATURES += " pci bluetooth wifi screen"

IMX_DEFAULT_BSP = "nxp"

USE_VT = "0"

KERNEL_IMAGETYPE:mx8-nxp-bsp = "Image.gz"
KERNEL_IMAGETYPE:mx9-nxp-bsp = "Image.gz"

WKS_FILE:mx8-nxp-bsp = "imx-imx-boot-singlepart.wks.in"
WKS_FILE:mx9-nxp-bsp = "imx-imx-boot-singlepart.wks.in"

# Set a more generic tuning for code reuse across parts
DEFAULTTUNE:mx8-nxp-bsp:fslc     ?= "armv8a-crc-crypto"
DEFAULTTUNE:mx8m-nxp-bsp:fslc    ?= "armv8a-crc-crypto"
DEFAULTTUNE:mx8qxp-nxp-bsp:fslc  ?= "armv8a-crc-crypto"
DEFAULTTUNE:mx8x-nxp-bsp:fslc    ?= "armv8a-crc-crypto"

NETMAN_PACKAGES = "\
	networkmanager \
	networkmanager-nmcli \
"

# Wayland distros should default to networkmanager
PREFERRED_CONNECTIVITY_MANAGER	 ?= " \
	${@bb.utils.contains('DISTRO', 'b2qt', '', \
		bb.utils.contains('DISTRO_FEATURES', 'wayland', \
		'networkmanager', '', d), d)} \
"
PREFERRED_CONNECTIVITY_MANAGER_PACKAGES	?= " \
	${@bb.utils.contains('PREFERRED_CONNECTIVITY_MANAGER', 'networkmanager', \
		'${NETMAN_PACKAGES}','', d)} \
"

# Variscite BSP default providers
PREFERRED_RPROVIDER_u-boot-default-env ?= "u-boot-variscite"

# Use i.MX Gstreamer Version for mx6 SoMs
MACHINE_GSTREAMER_1_0_PLUGIN:mx6-nxp-bsp = "imx-gst1.0-plugin"
PREFERRED_VERSION_gstreamer1.0:mx6-nxp-bsp ?= "1.20.3.imx"
PREFERRED_VERSION_gstreamer1.0-plugins-base:mx6-nxp-bsp ?= "1.20.3.imx"
PREFERRED_VERSION_gstreamer1.0-plugins-good:mx6-nxp-bsp ?= "1.20.3.imx"
PREFERRED_VERSION_gstreamer1.0-plugins-bad:mx6-nxp-bsp  ?= "1.20.3.imx"

# Use i.MX Gstreamer Version for mx6ul SoMs
MACHINE_GSTREAMER_1_0_PLUGIN:mx6ul-nxp-bsp = "imx-gst1.0-plugin"
PREFERRED_VERSION_gstreamer1.0:mx6ul-nxp-bsp ?= "1.20.3.imx"
PREFERRED_VERSION_gstreamer1.0-plugins-base:mx6ul-nxp-bsp ?= "1.20.3.imx"
PREFERRED_VERSION_gstreamer1.0-plugins-good:mx6ul-nxp-bsp ?= "1.20.3.imx"
PREFERRED_VERSION_gstreamer1.0-plugins-bad:mx6ul-nxp-bsp  ?= "1.20.3.imx"

# Use i.MX Gstreamer Version for mx7d SoMs
MACHINE_GSTREAMER_1_0_PLUGIN:mx7d-nxp-bsp = "imx-gst1.0-plugin"
PREFERRED_VERSION_gstreamer1.0:mx7d-nxp-bsp ?= "1.20.3.imx"
PREFERRED_VERSION_gstreamer1.0-plugins-base:mx7d-nxp-bsp ?= "1.20.3.imx"
PREFERRED_VERSION_gstreamer1.0-plugins-good:mx7d-nxp-bsp ?= "1.20.3.imx"
PREFERRED_VERSION_gstreamer1.0-plugins-bad:mx7d-nxp-bsp  ?= "1.20.3.imx"

# Use i.MX Gstreamer Version for mx8 SoMs
MACHINE_GSTREAMER_1_0_PLUGIN:mx8-nxp-bsp = "imx-gst1.0-plugin"

# Add VPU and Cortex M4/M7 firmware
MACHINE_FIRMWARE:append:mx8-nxp-bsp = " \
	firmware-imx-vpu-imx8 \
	freertos-variscite \
	"

MACHINE_EXTRA_RDEPENDS += " \
	gptfdisk \
	hostapd \
	hdparm \
	imx-kobs \
	iw \
	kernel-modules \
	kmod \
	${PREFERRED_CONNECTIVITY_MANAGER_PACKAGES} \
	packagegroup-tools-bluetooth \
	bluealsa \
	pm-utils \
	rng-tools \
	wpa-supplicant \
	wireless-regdb-static \
	u-boot-fw-utils \
	u-boot-splash \
	u-boot-default-env \
"

# Packages added to all images (including core-image-minimal)
IMAGE_INSTALL:append:mx8-nxp-bsp = " \
	kernel-image \
	kernel-devicetree \
"

IMAGE_INSTALL:append:mx9-nxp-bsp = " \
	kernel-image \
	kernel-devicetree \
"

IMAGE_FSTYPES = "tar.gz wic.gz"

# Wayland based distros add systemd to DISTRO_FEATURES
# Remove sysvinit or systemd based on DISTRO_FEATURES to avoid conflicts
DISTRO_FEATURES_BACKFILL_CONSIDERED:append = "${@bb.utils.contains('DISTRO_FEATURES', 'systemd', ' sysvinit', '', d)}"
DISTRO_FEATURES_BACKFILL_CONSIDERED:append = "${@bb.utils.contains('DISTRO_FEATURES', 'sysvinit', ' systemd', '', d)}"

# Use bluez-alsa instead of pulseaudio
DISTRO_FEATURES_BACKFILL_CONSIDERED:append = " pulseaudio"

# Enable virtualization
DISTRO_FEATURES:append:mx8-nxp-bsp = " virtualization"
DISTRO_FEATURES:append:mx9-nxp-bsp = " virtualization"
```

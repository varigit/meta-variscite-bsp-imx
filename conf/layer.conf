## conf/machine/imx91-var-som.conf
```bitbake
#@TYPE: Machine
#@NAME: Variscite VAR-SOM-MX91
#@SOC: i.MX91
#@DESCRIPTION: Machine configuration for Variscite VAR-SOM-MX91
#@MAINTAINER:
#
# http://www.variscite.com
MACHINEOVERRIDES =. "mx91:"

require conf/machine/include/imx-base.inc
require conf/machine/include/arm/armv8-2a/tune-cortexa55.inc

require include/variscite.inc
require include/variscite-tpm.inc

MACHINE_FEATURES += "nxpiw612-sdio"

KERNEL_DEVICETREE = " \
	freescale/imx91-var-som-symphony.dtb \
	freescale/imx91-var-som-symphony-1.x.dtb \
	freescale/imx91-var-dart-dt8mcustomboard.dtb \
	freescale/imx91-var-dart-sonata.dtb \
	freescale/imx91-var-som-symphony-ld.dtb \
	freescale/imx91-var-som-symphony-1.x-ld.dtb \
	freescale/imx91-var-dart-dt8mcustomboard-ld.dtb \
	freescale/imx91-var-dart-sonata-ld.dtb \
	freescale/imx91-var-som-wbe-symphony-1.x.dtb \
	freescale/imx91-var-som-wbe-symphony-1.x-ld.dtb \
"
UBOOT_DTB_NAME = "imx91-var-som-symphony.dtb"

LOADADDR = ""
UBOOT_SUFFIX = "bin"
UBOOT_MAKE_TARGET = ""

SPL_BINARY = "spl/u-boot-spl.bin"

UBOOT_CONFIG ??= "sd"
UBOOT_CONFIG[sd]   = "imx91_var_som_defconfig,sdcard"

# Set ATF platform name
ATF_PLATFORM = "imx91"

IMXBOOT_TARGETS_SD   = "flash_singleboot"
IMXBOOT_TARGETS = "${IMXBOOT_TARGETS_SD}"

IMX_BOOT_SOC_TARGET = "iMX91"
IMX_BOOT_SEEK = "32"

# We have to disable SERIAL_CONSOLE due to auto-serial-console
SERIAL_CONSOLES = "115200;ttyLP0"

DDR_FIRMWARE_NAME = " \
        lpddr4_dmem_1d_v202201.bin \
        lpddr4_dmem_2d_v202201.bin \
        lpddr4_imem_1d_v202201.bin \
        lpddr4_imem_2d_v202201.bin \
"

# Mender Configuration
require include/variscite-mender.inc
MENDER_UBOOT_CONFIG_SYS_MMC_ENV_PART ?= "0"
MENDER_STORAGE_DEVICE_BASE ?= "/dev/mmcblk0p"
MENDER_STORAGE_DEVICE ?= "/dev/mmcblk0"
MENDER_UBOOT_ENV_STORAGE_DEVICE_OFFSET_1 = "0x700000"
MENDER_UBOOT_ENV_STORAGE_DEVICE_OFFSET_2 = "0x740000"
```

## conf/machine/imx93-var-som.conf
```bitbake
#@TYPE: Machine
#@NAME: Variscite VAR-SOM-MX93
#@SOC: i.MX93
#@DESCRIPTION: Machine configuration for Variscite VAR-SOM-MX93
#@MAINTAINER: Nate Drude <nate.d@variscite.com>
#
# http://www.variscite.com
MACHINEOVERRIDES =. "mx93:"

require conf/machine/include/imx-base.inc
require conf/machine/include/arm/armv8-2a/tune-cortexa55.inc

require include/variscite.inc
require include/variscite-tpm.inc

PREFERRED_RPROVIDER_ethos-u-firmware ?= "freertos-variscite"

FREERTOS_VARISCITE_VERSION = "2.15.x"
PREFERRED_VERSION_freertos-variscite = "${FREERTOS_VARISCITE_VERSION}"
PREFERRED_VERSION_cortexm-toolchain-cross-armv8-m = "${@bb.utils.contains('FREERTOS_VARISCITE_VERSION', '2.13.x', '10.3-2021.10', '12.2.rel1', d)}"

MACHINE_FEATURES += "nxpiw612-sdio"

KERNEL_DEVICETREE = " \
    freescale/imx93-var-som-symphony.dtb \
    freescale/imx93-var-som-symphony-ld.dtb \
    \
    freescale/imx93-var-som-symphony-m33.dtb \
    \
    freescale/imx93-var-som-wbe-symphony.dtb \
    freescale/imx93-var-som-wbe-symphony-ld.dtb \
    \
    freescale/imx93-var-som-symphony-1.x.dtb \
    freescale/imx93-var-som-symphony-1.x-ld.dtb \
    \
    freescale/imx93-var-som-symphony-1.x-m33.dtb \
    \
    freescale/imx93-var-som-wbe-symphony-1.x.dtb \
    freescale/imx93-var-som-wbe-symphony-1.x-ld.dtb \
    \
    freescale/imx93-var-dart-dt8mcustomboard.dtb \
    freescale/imx93-var-dart-dt8mcustomboard-ld.dtb \
    \
    freescale/imx93-var-dart-dt8mcustomboard-m33.dtb \
    \
    freescale/imx93-var-dart-sonata.dtb \
    freescale/imx93-var-dart-sonata-ld.dtb \
    \
    freescale/imx93-var-dart-sonata-m33.dtb \
    \
    freescale/imx93-var-dart-wbe-sonata.dtb \
    freescale/imx93-var-dart-wbe-sonata-ld.dtb \
"
UBOOT_DTB_NAME ?= "imx93-var-som-symphony.dtb"

LOADADDR = ""
UBOOT_SUFFIX = "bin"
UBOOT_MAKE_TARGET = ""

SPL_BINARY = "spl/u-boot-spl.bin"

UBOOT_CONFIG ??= "sd"
UBOOT_CONFIG[sd]   = "imx93_var_som_defconfig,sdcard"

# Set ATF platform name
ATF_PLATFORM = "imx93"

IMXBOOT_TARGETS_SD   = "flash_singleboot"
IMXBOOT_TARGETS = "${IMXBOOT_TARGETS_SD}"

IMX_BOOT_SOC_TARGET = "iMX9"
IMX_BOOT_SEEK = "32"

# We have to disable SERIAL_CONSOLE due to auto-serial-console
SERIAL_CONSOLES = "115200;ttyLP0"

# Add additional firmware
MACHINE_FIRMWARE:append = " ethos-u-firmware"

DDR_FIRMWARE_NAME = " \
        lpddr4_dmem_1d_v202201.bin \
        lpddr4_dmem_2d_v202201.bin \
        lpddr4_imem_1d_v202201.bin \
        lpddr4_imem_2d_v202201.bin \
"

SECO_FIRMWARE_NAME:mx9-nxp-bsp = "mx93a0-ahab-container.img"

MACHINE_EXTRA_RRECOMMENDS:remove = "imx-m33-demos"

# Mender Configuration
require include/variscite-mender.inc
MENDER_UBOOT_CONFIG_SYS_MMC_ENV_PART ?= "0"
MENDER_STORAGE_DEVICE_BASE ?= "/dev/mmcblk0p"
MENDER_STORAGE_DEVICE ?= "/dev/mmcblk0"
MENDER_UBOOT_ENV_STORAGE_DEVICE_OFFSET_1 = "0x700000"
MENDER_UBOOT_ENV_STORAGE_DEVICE_OFFSET_2 = "0x740000"
```

## conf/machine/imx95-var-dart.conf
```bitbake
#@TYPE: Machine
#@NAME: Variscite DART-MX95
#@SOC: i.MX95
#@DESCRIPTION: Machine configuration for Variscite DART-MX95
#@MAINTAINER: Francesco FErraro <francesco.f@variscite.com>

MACHINEOVERRIDES =. "mx95:"

require conf/machine/include/imx-base.inc
require conf/machine/include/arm/armv8-2a/tune-cortexa55.inc

require include/variscite.inc
require include/variscite-tpm.inc

# Variscite BSP default providers
PREFERRED_PROVIDER_virtual/kernel:imx95-var-dart ?= "linux-variscite"
PREFERRED_PROVIDER_u-boot:imx95-var-dart ?= "u-boot-variscite"
PREFERRED_PROVIDER_u-boot-fw-utils:imx95-var-dart ?= "u-boot-fw-utils"
PREFERRED_PROVIDER_virtual/bootloader:imx95-var-dart ?= "u-boot-variscite"

MACHINE_FEATURES += "nxpiw612-sdio"

KERNEL_DEVICETREE = " \
    freescale/imx95-var-dart-dt8mcustomboard.dtb \
    freescale/imx95-var-dart-dt8mcustomboard-m7.dtb \
    freescale/imx95-var-dart-sonata.dtb \
    freescale/imx95-var-dart-sonata-m7.dtb \
"
UBOOT_DTB_NAME ?= "imx95-var-dart-dt8mcustomboard.dtb"

LOADADDR = ""
UBOOT_SUFFIX = "bin"
UBOOT_MAKE_TARGET = ""

SPL_BINARY = "spl/u-boot-spl.bin"

UBOOT_CONFIG ??= "sd"
UBOOT_CONFIG[sd]   = "imx95_var_dart_defconfig,sdcard"

# Set ATF platform name
ATF_PLATFORM = "imx95"
# OEI DDR Configuration
#  - DART-MX95 2GB:  lpddr5_2gb_6400mbps_train_timing
#  - DART-MX95 4GB:  lpddr5_4gb_6400mbps_train_timing
#  - DART-MX95 8GB:  lpddr5_8gb_6400mbps_train_timing
#  - DART-MX95 16GB: lpddr5_16gb_6400mbps_train_timing
OEI_DDR_CONFIG ?= "lpddr5_8gb_6400mbps_train_timing"
OEI_CORE   = "m33"
OEI_SOC    = "mx95"
OEI_BOARD  = "mx95-var-dart"
DDR_TYPE   = "lpddr5"

SYSTEM_MANAGER_CONFIG = "dart-mx95"
IMXBOOT_TARGETS = " \
    ${@bb.utils.contains('SYSTEM_MANAGER_CONFIG', 'dart-mx95-m7', 'flash_lpboot_sm_a55', 'flash_a55', d)} \
"

IMX_BOOT_SOC_TARGET = "iMX95"
IMX_BOOT_SEEK = "32"

# We have to disable SERIAL_CONSOLE due to auto-serial-console
SERIAL_CONSOLES = "115200;ttyLP0"

DDR_FIRMWARE_NAME = " \
    lpddr5_dmem_v202409.bin \
    lpddr5_dmem_qb_v202409.bin \
    lpddr5_imem_v202409.bin \
    lpddr5_imem_qb_v202409.bin \
"

MACHINE_EXTRA_RRECOMMENDS:remove = " imx-m7-demos"
BBMASK += "meta-imx/meta-imx-bsp/recipes-bsp/imx-mkimage/imx-boot_1.0.bbappend"

# Mender Configuration
require include/variscite-mender.inc
MENDER_UBOOT_CONFIG_SYS_MMC_ENV_PART ?= "0"
MENDER_STORAGE_DEVICE_BASE ?= "/dev/mmcblk0p"
MENDER_STORAGE_DEVICE ?= "/dev/mmcblk0"
MENDER_PARTITION_ALIGNMENT = "262144"
MENDER_UBOOT_ENV_STORAGE_DEVICE_OFFSET = "7340032"
MENDER_UBOOT_ENV_STORAGE_DEVICE_OFFSET_1 = "0x700000"
MENDER_UBOOT_ENV_STORAGE_DEVICE_OFFSET_2 = "0x740000"
```

## conf/machine/var-som-mx6.conf
```bitbake
#@TYPE: Machine
#@NAME: Variscite VAR-SOM-MX6
#@SOC: i.MX6Q/D/DL/S
#@DESCRIPTION: Machine configuration for Variscite VAR-SOM-MX6 VAR-SOM-SOLO/DUAL DART-MX6
#@MAINTAINER: Eran Matityahu <eran.m@variscite.com>
#
# http://www.variscite.com

MACHINEOVERRIDES =. "mx6:mx6dl:"
require conf/machine/include/imx-base.inc
require conf/machine/include/arm/armv7a/tune-cortexa9.inc

require include/variscite.inc
require include/variscite_ubi.inc

SERIAL_CONSOLES = "115200;ttymxc0"


KERNEL_IMAGETYPE = "uImage"

KERNEL_DEVICETREE = " \
		     nxp/imx/imx6dl-var-som-cap.dtb \
		     nxp/imx/imx6dl-var-som-res.dtb \
		     nxp/imx/imx6dl-var-som-vsc.dtb \
		     nxp/imx/imx6dl-var-som-symphony.dtb \
		     nxp/imx/imx6dl-var-som-solo-cap.dtb \
		     nxp/imx/imx6dl-var-som-solo-res.dtb \
		     nxp/imx/imx6dl-var-som-solo-vsc.dtb \
		     nxp/imx/imx6dl-var-som-solo-symphony.dtb \
		     nxp/imx/imx6q-var-dart.dtb \
		     nxp/imx/imx6q-var-som-cap.dtb \
		     nxp/imx/imx6q-var-som-res.dtb \
		     nxp/imx/imx6q-var-som-vsc.dtb \
		     nxp/imx/imx6q-var-som-symphony.dtb \
		     nxp/imx/imx6qp-var-som-cap.dtb \
		     nxp/imx/imx6qp-var-som-res.dtb \
		     nxp/imx/imx6qp-var-som-vsc.dtb \
		     nxp/imx/imx6qp-var-som-symphony.dtb \
		     "

SOC_DEFAULT_WKS_FILE = "imx-uboot-spl-bootpart.wks.in"

UBOOT_MAKE_TARGET = ""
SPL_BINARY          = "SPL"
UBOOT_SUFFIX        = "img"
UBOOT_CONFIG ??= "nand sd "
# The above order matters. The last one will be also called u-boot-${MACHINE} and will be used to create the sdcard.
UBOOT_CONFIG[sd] = "mx6var_som_sd_config,sdcard"
UBOOT_CONFIG[nand] = "mx6var_som_nand_config,ubifs"

MACHINE_EXTRA_RDEPENDS += " \
			   linux-firmware-wl12xx \
			   linux-firmware-wl18xx \
			   wl18xx-calibrator \
			   wl18xx-target-scripts \
			   wlconf \
			   "
```

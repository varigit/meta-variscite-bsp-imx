## conf/layer.conf
```bitbake
# We have a conf and classes directory, add to BBPATH
BBPATH .= ":${LAYERDIR}"

# We have a packages directory, add to BBFILES
BBFILES += "${LAYERDIR}/recipes-*/*/*.bb \
            ${LAYERDIR}/recipes-*/*/*.bbappend"

BBFILE_COLLECTIONS += "variscite-bsp"
BBFILE_PATTERN_variscite-bsp := "^${LAYERDIR}/"
BBFILE_PRIORITY_variscite-bsp = "9"

LAYERSERIES_COMPAT_variscite-bsp = "wrynose"

LAYERDEPENDS_variscite-bsp = " \
    variscite-bsp-common \
    fsl-bsp-release \
"

BBFILES_DYNAMIC += " \
    fsl-bsp-release:${LAYERDIR}/dynamic-layers/fsl-bsp-release/*/*/*.bb \
    fsl-bsp-release:${LAYERDIR}/dynamic-layers/fsl-bsp-release/*/*/*.bbappend \
    mender:${LAYERDIR}/dynamic-layers/mender/*/*/*.bb \
    mender:${LAYERDIR}/dynamic-layers/mender/*/*/*.bbappend \
    nxp-matter-baseline:${LAYERDIR}/dynamic-layers/nxp-matter-baseline/*/*/*.bb \
    nxp-matter-baseline:${LAYERDIR}/dynamic-layers/nxp-matter-baseline/*/*/*.bbappend \
"
```

## conf/machine/imx6ul-var-dart.conf
```bitbake
#@TYPE: Machine
#@NAME: Variscite DART-6UL
#@SOC: i.MX6UL
#@DESCRIPTION: Machine configuration for Variscite DART-6UL
#@MAINTAINER: Eran Matityahu <eran.m@variscite.com>
#
# http://www.variscite.com

MACHINEOVERRIDES =. "mx6ul:"
require conf/machine/include/imx-base.inc
require conf/machine/include/arm/armv7a/tune-cortexa7.inc

require include/variscite.inc
require include/variscite_bcm43xx.inc
require include/variscite_ubi.inc

MACHINE_FEATURES += "nxpiw612-sdio"

SERIAL_CONSOLES = "115200;ttymxc0"

KERNEL_IMAGETYPE = "zImage"

KERNEL_DEVICETREE = " \
		     nxp/imx/imx6ull-var-dart-6ulcustomboard-emmc-sd-card.dtb \
		     nxp/imx/imx6ull-var-dart-6ulcustomboard-emmc-sd-card-wm8731.dtb \
		     nxp/imx/imx6ull-var-dart-6ulcustomboard-emmc-wifi-iw61x.dtb \
		     nxp/imx/imx6ull-var-dart-6ulcustomboard-emmc-wifi-brcm.dtb \
		     nxp/imx/imx6ull-var-dart-6ulcustomboard-emmc-wifi-brcm-wm8731.dtb \
		     nxp/imx/imx6ull-var-dart-6ulcustomboard-nand-sd-card.dtb \
		     nxp/imx/imx6ull-var-dart-6ulcustomboard-nand-sd-card-wm8731.dtb \
		     nxp/imx/imx6ull-var-dart-6ulcustomboard-nand-wifi-iw61x.dtb \
		     nxp/imx/imx6ull-var-dart-6ulcustomboard-nand-wifi-brcm.dtb \
		     nxp/imx/imx6ull-var-dart-6ulcustomboard-nand-wifi-brcm-wm8731.dtb \
		     nxp/imx/imx6ull-var-som-concerto-board-emmc-sd-card.dtb \
		     nxp/imx/imx6ull-var-som-concerto-board-emmc-sd-card-wm8731.dtb \
		     nxp/imx/imx6ull-var-som-concerto-board-emmc-wifi.dtb \
		     nxp/imx/imx6ull-var-som-concerto-board-emmc-wifi-wm8731.dtb \
		     nxp/imx/imx6ull-var-som-concerto-board-nand-sd-card.dtb \
		     nxp/imx/imx6ull-var-som-concerto-board-nand-sd-card-wm8731.dtb \
		     nxp/imx/imx6ull-var-som-concerto-board-nand-wifi.dtb \
		     nxp/imx/imx6ull-var-som-concerto-board-nand-wifi-wm8731.dtb \
		     nxp/imx/imx6ull-var-som-symphony-board-emmc-sd-card.dtb \
		     nxp/imx/imx6ull-var-som-symphony-board-emmc-sd-card-wm8731.dtb \
		     nxp/imx/imx6ull-var-som-symphony-board-emmc-wifi.dtb \
		     nxp/imx/imx6ull-var-som-symphony-board-emmc-wifi-wm8731.dtb \
		     nxp/imx/imx6ull-var-som-symphony-board-nand-sd-card.dtb \
		     nxp/imx/imx6ull-var-som-symphony-board-nand-sd-card-wm8731.dtb \
		     nxp/imx/imx6ull-var-som-symphony-board-nand-wifi.dtb \
		     nxp/imx/imx6ull-var-som-symphony-board-nand-wifi-wm8731.dtb \
		     nxp/imx/imx6ul-var-dart-6ulcustomboard-emmc-sd-card.dtb \
		     nxp/imx/imx6ul-var-dart-6ulcustomboard-emmc-sd-card-wm8731.dtb \
		     nxp/imx/imx6ul-var-dart-6ulcustomboard-emmc-wifi-iw61x.dtb \
		     nxp/imx/imx6ul-var-dart-6ulcustomboard-emmc-wifi-brcm.dtb \
		     nxp/imx/imx6ul-var-dart-6ulcustomboard-emmc-wifi-brcm-wm8731.dtb \
		     nxp/imx/imx6ul-var-dart-6ulcustomboard-nand-sd-card.dtb \
		     nxp/imx/imx6ul-var-dart-6ulcustomboard-nand-sd-card-wm8731.dtb \
		     nxp/imx/imx6ul-var-dart-6ulcustomboard-nand-wifi-iw61x.dtb \
		     nxp/imx/imx6ul-var-dart-6ulcustomboard-nand-wifi-brcm.dtb \
		     nxp/imx/imx6ul-var-dart-6ulcustomboard-nand-wifi-brcm-wm8731.dtb \
		     nxp/imx/imx6ul-var-som-concerto-board-emmc-sd-card.dtb \
		     nxp/imx/imx6ul-var-som-concerto-board-emmc-sd-card-wm8731.dtb \
		     nxp/imx/imx6ul-var-som-concerto-board-emmc-wifi.dtb \
		     nxp/imx/imx6ul-var-som-concerto-board-emmc-wifi-wm8731.dtb \
		     nxp/imx/imx6ul-var-som-concerto-board-nand-sd-card.dtb \
		     nxp/imx/imx6ul-var-som-concerto-board-nand-sd-card-wm8731.dtb \
		     nxp/imx/imx6ul-var-som-concerto-board-nand-wifi.dtb \
		     nxp/imx/imx6ul-var-som-concerto-board-nand-wifi-wm8731.dtb \
		     nxp/imx/imx6ul-var-som-symphony-board-emmc-sd-card.dtb \
		     nxp/imx/imx6ul-var-som-symphony-board-emmc-sd-card-wm8731.dtb \
		     nxp/imx/imx6ul-var-som-symphony-board-emmc-wifi.dtb \
		     nxp/imx/imx6ul-var-som-symphony-board-emmc-wifi-wm8731.dtb \
		     nxp/imx/imx6ul-var-som-symphony-board-nand-sd-card.dtb \
		     nxp/imx/imx6ul-var-som-symphony-board-nand-sd-card-wm8731.dtb \
		     nxp/imx/imx6ul-var-som-symphony-board-nand-wifi.dtb \
		     nxp/imx/imx6ul-var-som-symphony-board-nand-wifi-wm8731.dtb \
		     nxp/imx/imx6ulz-var-dart-6ulcustomboard-emmc-sd-card.dtb \
		     nxp/imx/imx6ulz-var-dart-6ulcustomboard-emmc-sd-card-wm8731.dtb \
		     nxp/imx/imx6ulz-var-dart-6ulcustomboard-emmc-wifi-iw61x.dtb \
		     nxp/imx/imx6ulz-var-dart-6ulcustomboard-emmc-wifi-brcm.dtb \
		     nxp/imx/imx6ulz-var-dart-6ulcustomboard-emmc-wifi-brcm-wm8731.dtb \
		     nxp/imx/imx6ulz-var-dart-6ulcustomboard-nand-sd-card.dtb \
		     nxp/imx/imx6ulz-var-dart-6ulcustomboard-nand-sd-card-wm8731.dtb \
		     nxp/imx/imx6ulz-var-dart-6ulcustomboard-nand-wifi-iw61x.dtb \
		     nxp/imx/imx6ulz-var-dart-6ulcustomboard-nand-wifi-brcm.dtb \
		     nxp/imx/imx6ulz-var-dart-6ulcustomboard-nand-wifi-brcm-wm8731.dtb \
		     nxp/imx/imx6ulz-var-som-concerto-board-emmc-sd-card.dtb \
		     nxp/imx/imx6ulz-var-som-concerto-board-emmc-sd-card-wm8731.dtb \
		     nxp/imx/imx6ulz-var-som-concerto-board-emmc-wifi.dtb \
		     nxp/imx/imx6ulz-var-som-concerto-board-emmc-wifi-wm8731.dtb \
		     nxp/imx/imx6ulz-var-som-concerto-board-nand-sd-card.dtb \
		     nxp/imx/imx6ulz-var-som-concerto-board-nand-sd-card-wm8731.dtb \
		     nxp/imx/imx6ulz-var-som-concerto-board-nand-wifi.dtb \
		     nxp/imx/imx6ulz-var-som-concerto-board-nand-wifi-wm8731.dtb \
		     nxp/imx/imx6ulz-var-som-symphony-board-emmc-sd-card.dtb \
		     nxp/imx/imx6ulz-var-som-symphony-board-emmc-sd-card-wm8731.dtb \
		     nxp/imx/imx6ulz-var-som-symphony-board-emmc-wifi.dtb \
		     nxp/imx/imx6ulz-var-som-symphony-board-emmc-wifi-wm8731.dtb \
		     nxp/imx/imx6ulz-var-som-symphony-board-nand-sd-card.dtb \
		     nxp/imx/imx6ulz-var-som-symphony-board-nand-sd-card-wm8731.dtb \
		     nxp/imx/imx6ulz-var-som-symphony-board-nand-wifi.dtb \
		     nxp/imx/imx6ulz-var-som-symphony-board-nand-wifi-wm8731.dtb \
		     "

SOC_DEFAULT_WKS_FILE = "var-imx-uboot-spl-bootpart.wks.in"

UBOOT_MAKE_TARGET = ""
SPL_BINARY = "SPL"
UBOOT_SUFFIX = "img"
UBOOT_CONFIG ??= "nand sd "
# The above order matters. The last one will be also called u-boot-${MACHINE} and will be used to create the sdcard.
UBOOT_CONFIG[sd] = "imx6ul_var_dart_mmc_defconfig,sdcard"
UBOOT_CONFIG[nand] = "imx6ul_var_dart_nand_defconfig,ubifs"

MACHINE_FIRMWARE:append = " linux-firmware-imx-sdma-imx6q"

# psplash.bbappend from meta-imx delays start of progress bar significantly and provides worse UI experience
BBMASK += "meta-imx/meta-imx-bsp/recipes-core/psplash/psplash_git.bbappend"
```

## conf/machine/imx8mm-var-dart.conf
```bitbake
#@TYPE: Machine
#@NAME: Variscite DART-MX8M-MINI
#@SOC: i.MX8MM
#@DESCRIPTION: Machine configuration for Variscite DART-MX8M-MINI and VAR-SOM-MX8M-MINI
#@MAINTAINER: Nate Drude <nate.d@variscite.com>
#
# http://www.variscite.com

MACHINEOVERRIDES =. "mx8mm:"
require conf/machine/include/imx-base.inc
require conf/machine/include/arm/armv8a/tune-cortexa53.inc

require include/variscite.inc
require include/variscite_bcm43xx.inc
require include/variscite-tpm.inc

MACHINE_FEATURES:append = " nxpiw612-sdio"

KERNEL_DEVICETREE = " \
	freescale/imx8mm-var-dart-1.x-dt8mcustomboard.dtb \
	freescale/imx8mm-var-dart-1.x-dt8mcustomboard-m4.dtb \
	freescale/imx8mm-var-dart-dt8mcustomboard.dtb \
	freescale/imx8mm-var-dart-dt8mcustomboard-m4.dtb \
	freescale/imx8mm-var-dart-wbe-dt8mcustomboard.dtb \
	freescale/imx8mm-var-dart-wbe-dt8mcustomboard-m4.dtb \
	freescale/imx8mm-var-som-1.x-symphony.dtb \
	freescale/imx8mm-var-som-1.x-symphony-1.x.dtb \
	freescale/imx8mm-var-som-1.x-symphony-m4.dtb \
	freescale/imx8mm-var-som-1.x-symphony-1.x-m4.dtb \
	freescale/imx8mm-var-som-symphony.dtb \
	freescale/imx8mm-var-som-symphony-1.x.dtb \
	freescale/imx8mm-var-som-symphony-m4.dtb \
	freescale/imx8mm-var-som-symphony-1.x-m4.dtb \
	freescale/imx8mm-var-som-wbe-symphony.dtb \
	freescale/imx8mm-var-som-wbe-symphony-1.x.dtb \
	freescale/imx8mm-var-som-wbe-symphony-m4.dtb \
	freescale/imx8mm-var-som-wbe-symphony-1.x-m4.dtb \
	freescale/imx8mm-var-dart-1.x-sonata.dtb \
	freescale/imx8mm-var-dart-1.x-sonata-m4.dtb \
	freescale/imx8mm-var-dart-sonata.dtb \
	freescale/imx8mm-var-dart-sonata-m4.dtb \
	freescale/imx8mm-var-dart-wbe-sonata.dtb \
	freescale/imx8mm-var-dart-wbe-sonata-m4.dtb \
"

MACHINE_EXTRA_RRECOMMENDS:remove = " imx-m4-demos"

UBOOT_CONFIG ??= "sd"
UBOOT_CONFIG[sd] = "imx8mm_var_dart_config,sdcard"
SPL_BINARY = "spl/u-boot-spl.bin"

ATF_PLATFORM = "imx8mm"
ATF_LOAD_ADDR = "0x920000"

# Set DDR FIRMWARE
DDR_FIRMWARE_NAME = " \
	ddr4_imem_1d.bin \
	ddr4_dmem_1d.bin \
	ddr4_imem_2d.bin \
	ddr4_dmem_2d.bin \
	lpddr4_pmu_train_1d_imem.bin \
	lpddr4_pmu_train_1d_dmem.bin \
	lpddr4_pmu_train_2d_imem.bin \
	lpddr4_pmu_train_2d_dmem.bin \
"
# Set U-Boot DTB
UBOOT_DTB_NAME ?= "imx8mm-var-dart-dt8mcustomboard.dtb"
UBOOT_DTB_EXTRA ?= "imx8mm-var-som-symphony.dtb"

# Set imx-mkimage boot target
IMXBOOT_TARGETS = "flash_lpddr4_ddr4_evk"

IMX_BOOT_SOC_TARGET = "iMX8MM"

# Extra firmware package name, that is required to build boot container for fslc bsp
IMX_EXTRA_FIRMWARE = "firmware-imx-8m"

SERIAL_CONSOLES = "115200;ttymxc0 115200;ttymxc3"

IMAGE_BOOTLOADER = "imx-boot"

ROOTFS_SIZE = "3700"
LOADADDR = ""
UBOOT_SUFFIX = "bin"
UBOOT_MAKE_TARGET = "all"
IMX_BOOT_SEEK = "33"

# If you change TEE_LOAD_ADDR, make sure to align patch for soc.mak
TEE_LOAD_ADDR ?= "0x56000000"
TEE_CFG_DDR_SIZE ?= "0x80000000"

# Mender Configuration
require include/variscite-mender.inc
MENDER_UBOOT_CONFIG_SYS_MMC_ENV_PART ?= "0"
MENDER_STORAGE_DEVICE_BASE ?= "/dev/mmcblk2p"
MENDER_STORAGE_DEVICE ?= "/dev/mmcblk2"
MENDER_PARTITION_ALIGNMENT = "262144"
MENDER_UBOOT_ENV_STORAGE_DEVICE_OFFSET = "7340032"
MENDER_UBOOT_ENV_STORAGE_DEVICE_OFFSET_1 = "0x700000"
MENDER_UBOOT_ENV_STORAGE_DEVICE_OFFSET_2 = "0x740000"

# Must match U-Boot CONFIG_SYS_MMC_ENV_DEV.
MENDER_UBOOT_STORAGE_DEVICE = "2"
```

## conf/machine/imx8mn-var-som.conf
```bitbake
#@TYPE: Machine
#@NAME: Variscite VAR-SOM-MX8M-NANO
#@SOC: i.MX8MN
#@DESCRIPTION: Machine configuration for Variscite VAR-SOM-MX8M-NANO
#@MAINTAINER: Nate Drude <nate.d@variscite.com>
#
# http://www.variscite.com

MACHINEOVERRIDES =. "mx8mn:"
require conf/machine/include/imx-base.inc
require conf/machine/include/arm/armv8a/tune-cortexa53.inc

require include/variscite.inc
require include/variscite_bcm43xx.inc
require include/variscite-tpm.inc

MACHINE_FEATURES:append = " nxpiw612-sdio"

KERNEL_DEVICETREE = " \
	freescale/imx8mn-var-som-1.x-symphony.dtb \
	freescale/imx8mn-var-som-1.x-symphony-m7.dtb \
	freescale/imx8mn-var-som-1.x-symphony-root.dtb \
	freescale/imx8mn-var-som-1.x-symphony-1.x.dtb \
	freescale/imx8mn-var-som-1.x-symphony-1.x-m7.dtb \
	freescale/imx8mn-var-som-1.x-symphony-1.x-root.dtb \
	freescale/imx8mn-var-som-inmate.dtb \
	freescale/imx8mn-var-som-symphony-1.x.dtb \
	freescale/imx8mn-var-som-symphony-1.x-m7.dtb \
	freescale/imx8mn-var-som-symphony-1.x-root.dtb \
	freescale/imx8mn-var-som-symphony.dtb \
	freescale/imx8mn-var-som-symphony-m7.dtb \
	freescale/imx8mn-var-som-symphony-root.dtb \
	freescale/imx8mn-var-som-wbe-symphony-1.x.dtb \
	freescale/imx8mn-var-som-wbe-symphony-1.x-m7.dtb \
	freescale/imx8mn-var-som-wbe-symphony-1.x-root.dtb \
	freescale/imx8mn-var-som-wbe-symphony.dtb \
	freescale/imx8mn-var-som-wbe-symphony-m7.dtb \
	freescale/imx8mn-var-som-wbe-symphony-root.dtb \
"

MACHINE_EXTRA_RRECOMMENDS:remove = " imx-m7-demos"

UBOOT_CONFIG ??= "sd"
UBOOT_CONFIG[sd] = "imx8mn_var_som_config,sdcard"
SPL_BINARY = "spl/u-boot-spl.bin"

ATF_PLATFORM = "imx8mn"
ATF_LOAD_ADDR = "0x960000"

# Extra firmware package name, that is required to build boot container for fslc bsp
IMX_EXTRA_FIRMWARE = "firmware-imx-8m"

# Set DDR FIRMWARE
DDR_FIRMWARE_NAME = " \
	ddr4_imem_1d_201810.bin \
	ddr4_dmem_1d_201810.bin \
	ddr4_imem_2d_201810.bin \
	ddr4_dmem_2d_201810.bin \
"

# Set U-Boot DTB
UBOOT_DTB_NAME ?= "imx8mn-var-som-symphony.dtb"

# Set imx-mkimage boot target
IMXBOOT_TARGETS = "flash_ddr4_evk"
IMX_BOOT_SOC_TARGET = "iMX8MN"

SERIAL_CONSOLES = "115200;ttymxc3"

IMAGE_BOOTLOADER = "imx-boot"

ROOTFS_SIZE = "3700"
LOADADDR = ""
UBOOT_SUFFIX = "bin"
UBOOT_MAKE_TARGET = "all"
IMX_BOOT_SEEK = "32"
```

## conf/machine/imx8qxp-var-som.conf
```bitbake
#@TYPE: Machine
#@NAME: Variscite VAR-SOM-MX8X
#@SOC: i.MX8QXP
#@DESCRIPTION: Machine configuration for Variscite VAR-SOM-MX8X
#@MAINTAINER: Nate Drude <nate.d@variscite.com>
#
# http://www.variscite.com

MACHINEOVERRIDES =. "mx8qxp:mx8qxpc0:"
require conf/machine/include/imx-base.inc
require conf/machine/include/arm/armv8a/tune-cortexa35.inc

require include/variscite.inc
require include/variscite_bcm43xx.inc
require include/variscite-tpm.inc

PREFERRED_VERSION_cortexm-toolchain-cross-armv7e-m = "10.3-2021.10"

MACHINE_FEATURES:remove = "nxpiw612-sdio"

KERNEL_DEVICETREE = " \
	freescale/imx8qxp-var-som-symphony-1.x-sd.dtb \
	freescale/imx8qxp-var-som-symphony-1.x-wifi.dtb \
	freescale/imx8qxp-var-som-symphony-1.x-wifi-m4.dtb \
	freescale/imx8qxp-var-som-symphony-1.x-sd-m4.dtb \
	freescale/imx8qxp-var-som-symphony-sd.dtb \
	freescale/imx8qxp-var-som-symphony-wifi.dtb \
	freescale/imx8qxp-var-som-symphony-wifi-m4.dtb \
	freescale/imx8qxp-var-som-symphony-sd-m4.dtb \
"

SPL_BINARY = "spl/u-boot-spl.bin"
UBOOT_SUFFIX = "bin"
UBOOT_CONFIG ??= "sd"
UBOOT_CONFIG[sd] = "imx8qxp_var_som_defconfig,sdcard"

ATF_PLATFORM = "imx8qx"
IMX_BOOT_SOC_TARGET = "iMX8QX"

# Set U-Boot DTB
UBOOT_DTB_NAME = "imx8qxp-var-som-symphony.dtb"

# Set imx-mkimage boot target
IMXBOOT_TARGETS = "flash_spl"

SERIAL_CONSOLES = "115200;ttyLP3"

IMAGE_BOOTLOADER = "imx-boot"

ROOTFS_SIZE = "3700"
LOADADDR = ""
UBOOT_MAKE_TARGET = "all"
IMX_BOOT_SEEK = "32"
```
